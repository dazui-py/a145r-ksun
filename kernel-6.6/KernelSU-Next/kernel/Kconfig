## kernel-6.6/KernelSU-Next/kernel/Kconfig
```kconfig
menu "KernelSU"

config KSU
        tristate "KernelSU function support"
        depends on KPROBES
        default y
        help
          Enable kernel-level root privileges on Android System.
          Requires CONFIG_KPROBES for kernel hooking support.
          To compile as a module, choose M here: the
          module will be called kernelsu.

config KSU_DEBUG
        bool "KernelSU debug mode"
        depends on KSU
        default n
        help
          Enable KernelSU debug mode.

menu "KernelSU - SUSFS"

config KSU_SUSFS
        bool "KernelSU addon - SUSFS"
        depends on KSU
        depends on THREAD_INFO_IN_TASK
        default y
        help
          Patch and Enable SUSFS to kernel with KernelSU.

config KSU_SUSFS_SUS_PATH
        bool "Enable to hide suspicious path"
        depends on KSU_SUSFS
        default y

config KSU_SUSFS_SUS_MOUNT
        bool "Enable to hide suspicious mounts"
        depends on KSU_SUSFS
        default y

config KSU_SUSFS_SUS_KSTAT
        bool "Enable to spoof suspicious kstat"
        depends on KSU_SUSFS
        default y

config KSU_SUSFS_SPOOF_UNAME
        bool "Enable to spoof uname"
        depends on KSU_SUSFS
        default y

config KSU_SUSFS_ENABLE_LOG
        bool "Enable logging susfs log to kernel"
        depends on KSU_SUSFS
        default y

config KSU_SUSFS_HIDE_KSU_SUSFS_SYMBOLS
        bool "Enable to automatically hide ksu and susfs symbols from /proc/kallsyms"
        depends on KSU_SUSFS
        default y

config KSU_SUSFS_SPOOF_CMDLINE_OR_BOOTCONFIG
        bool "Enable to spoof /proc/bootconfig (gki) or /proc/cmdline (non-gki)"
        depends on KSU_SUSFS
        default y

config KSU_SUSFS_OPEN_REDIRECT
        bool "Enable to redirect a path to be opened with another path"
        depends on KSU_SUSFS
        default y

config KSU_SUSFS_SUS_MAP
        bool "Enable to hide some mmapped real file from different proc maps interfaces"
        depends on KSU_SUSFS
        default y

endmenu

endmenu
```
